## overlays/keystone/package/filtering-libcoap/Config.in
```kconfig
config BR2_PACKAGE_FILTERING_LIBCOAP
        bool "Filtering libcoap"
        help
          A version of libcoap tailored to the filtering-proxy
```

## overlays/keystone/package/filtering-proxy/Config.in
```kconfig
config BR2_PACKAGE_FILTERING_PROXY
        bool "Filtering Proxy"
        depends on BR2_PACKAGE_HOST_KEYSTONE_SDK
        depends on BR2_PACKAGE_KEYSTONE_RUNTIME
        help
          Privacy-preserving en-route filtering of OSCORE-NG traffic
```
